## applications/nrf5340_audio/nrf5340_audio_app/Kconfig
```kconfig
#
# Copyright (c) 2018 Nordic Semiconductor ASA
#
# SPDX-License-Identifier: LicenseRef-Nordic-5-Clause
#

# Kconfig - general configuration options

mainmenu "nRF5340 Audio Project"

config ZEPHYR_BASE
	string
	option env="ZEPHYR_BASE"

source "$ZEPHYR_BASE/Kconfig.zephyr"

#----------------------------------------------------------------------------#
menu "nRF5340 Audio Config"
config BUTTON_DEBOUNCE_MS
	int "Button debounce time in ms"
	default 50

choice NRF5340_AUDIO_TRANSPORT_MODE
	prompt "Choose BIS or CIS for ISO transport"
	default TRANSPORT_CIS

config TRANSPORT_BIS
	select EXPERIMENTAL
	bool "Use BIS ISO channel for audio streaming"

config TRANSPORT_CIS
	select EXPERIMENTAL
	bool "Use CIS ISO channel for audio streaming"

endchoice

#----------------------------------------------------------------------------#
menu "Audio"
config AUDIO_SAMPLE_RATE_HZ
	int "Sample rate Hz"
	range 48000 48000
	default 48000
	help
		For now 48kHz is the only sample rate supported

choice AUDIO_BIT_DEPTH
	prompt "Audio bit depth"
	default AUDIO_BIT_DEPTH_16
	help
		Select the bit depth for audio

config AUDIO_BIT_DEPTH_16
	bool "16 bit audio"

config AUDIO_BIT_DEPTH_24
	bool "24 bit audio"
	help
		Setting a 24 bit depth for I2S leads to a mismatch between
		requested MCK and actual MCK. Even though requested LRCLK is
		48 kHz, actual LRCLK might be 42 kHz or 51 kHz, depending on
		ratio and ACLK settings

config AUDIO_BIT_DEPTH_32
	bool "32 bit audio"
endchoice

config AUDIO_BIT_DEPTH_BITS
	int "Data storage bit depth"
	range 16 32
	default 16 if AUDIO_BIT_DEPTH_16
	default 32 if AUDIO_BIT_DEPTH_24
	default 32 if AUDIO_BIT_DEPTH_32
	help
		Bit depth of one sample in storage. Note that 24 bit depth
		requires 32 bit for storage

config AUDIO_BIT_DEPTH_OCTETS
	int "Data storage bit depth in octets"
	range 2 4
	default 2 if AUDIO_BIT_DEPTH_16
	default 4 if AUDIO_BIT_DEPTH_24
	default 4 if AUDIO_BIT_DEPTH_32
	help
		Bit depth of one sample in storage given in octets.
		Note that 24 bit depth requires 4 octets for storage

choice AUDIO_SOURCE_GATEWAY
	prompt "Audio source for gateway"
	default AUDIO_SOURCE_USB
	help
		Select audio source for the gateway

config AUDIO_SOURCE_USB
	bool "Use USB as audio source"
	help
		Set USB as audio source for gateway. Note that this forces the
		stream to be unidirectional because of CPU load

config AUDIO_SOURCE_I2S
	bool "Use I2S as audio source"
endchoice

choice AUDIO_HEADSET_CHANNEL
	prompt "Headset audio channel assignment"
	default AUDIO_HEADSET_CHANNEL_RUNTIME
	help
		Set whether audio channel assignment for the headset
		should happen at runtime or compile-time.

config AUDIO_HEADSET_CHANNEL_RUNTIME
	bool "Select at runtime"
	help
		Make channel selection at runtime. Selected value is stored in persistent memory.
		Left channel: Hold volume-down button on headset while resetting headset.
		Right channel: Hold volume-up button on headset while resetting headset.

config AUDIO_HEADSET_CHANNEL_COMPILE_TIME
	bool "Set at compile-time"
	help
		Set channel selection at compile-time.
endchoice

if AUDIO_HEADSET_CHANNEL_COMPILE_TIME

config AUDIO_HEADSET_CHANNEL
	int "Audio channel used by headset"
	range 0 1
	default 0
	help
		Audio channel compile-time selection.
		Left = 0.
		Right = 1.

endif # AUDIO_HEADSET_CHANNEL_COMPILE_TIME

menu "SW Codec"

choice SW_CODEC_DEFAULT
	prompt "Starting SW codec"
	default SW_CODEC_LC3
	help
		Select the default codec to use on start up

config SW_CODEC_LC3
	bool "LC3"
	help
		LC3 is the mandatory codec for LE Audio

config SW_CODEC_SBC
	bool "SBC"
	help
		SBC is the mandatory codec for BR/EDR
endchoice


menu "Encoder"
#----------------------------------------------------------------------------#
menu "LC3"
visible if SW_CODEC_LC3

config SW_CODEC_LC3_MONO_BITRATE
	int "Bitrate for LC3"
	default 96000

config SW_CODEC_LC3_7_5_MS_FRAMESIZE
	int "Select 10 or 7.5 ms framesize - 7.5 ms frame size is not tested"
	range 0 1
	default 0
	help
		LC3 supports frame sizes of 7.5 and 10 ms
		0: 10 ms frame size
		1: 7.5 ms frame size
		If a shorter frame size is selected, it's recommended to change
		BLE_ISO_CONN_INTERVAL to match that. If USB is
		selected as audio source, we need to have a frame size of 10 ms
		since USB sends 1ms at a time

#----------------------------------------------------------------------------#
menu "Encoder sample rates"

config SW_CODEC_LC3_ENC_SAMPLE_RATE_8KHZ_SUPPORT
	bool "Support encoding 8 kHz"
	default n

config SW_CODEC_LC3_ENC_SAMPLE_RATE_16KHZ_SUPPORT
	bool "Support encoding 16 kHz"
	default n

config SW_CODEC_LC3_ENC_SAMPLE_RATE_24KHZ_SUPPORT
	bool "Support encoding 24 kHz"
	default n

config SW_CODEC_LC3_ENC_SAMPLE_RATE_32KHZ_SUPPORT
	bool "Support encoding 32 kHz"
	default n

config SW_CODEC_LC3_ENC_SAMPLE_RATE_441KHZ_SUPPORT
	bool "Support encoding 44.1 kHz"
	default n

config SW_CODEC_LC3_ENC_SAMPLE_RATE_48KHZ_SUPPORT
	bool "Support encoding 48 kHz"
	default y

endmenu #Encoder sample rates

#----------------------------------------------------------------------------#
menu "Decoder sample rates"

config SW_CODEC_LC3_DEC_SAMPLE_RATE_8KHZ_SUPPORT
	bool "Support decoding 8 kHz"
	default n

config SW_CODEC_LC3_DEC_SAMPLE_RATE_16KHZ_SUPPORT
	bool "Support decoding 16 kHz"
	default n

config SW_CODEC_LC3_DEC_SAMPLE_RATE_24KHZ_SUPPORT
	bool "Support decoding 24 kHz"
	default n

config SW_CODEC_LC3_DEC_SAMPLE_RATE_32KHZ_SUPPORT
	bool "Support decoding 32 kHz"
	default n

config SW_CODEC_LC3_DEC_SAMPLE_RATE_441KHZ_SUPPORT
	bool "Support decoding 44.1 kHz"
	default n

config SW_CODEC_LC3_DEC_SAMPLE_RATE_48KHZ_SUPPORT
	bool "Support decoding 48 kHz"
	default y

endmenu #Decoder sample rates

endmenu #LC3

#----------------------------------------------------------------------------#
menu "SBC"
visible if SW_CODEC_SBC

config SW_CODEC_SBC_MONO_BITRATE
	int "Bitrate for encoded SBC frames for mono channel"
	default 140000

config SW_CODEC_SBC_NUM_FRAMES_PER_BLE_PACKET
	int "Number of packets be transmitted in one connection interval"
	range 5 5
	help
		For the current SBC codec default setting, it is possible to send
		5 SBC encoded frames in a 10 ms connection interval since a
		SBC frame is 2 ms internally.

	default 5

config SW_CODEC_SBC_NO_OF_BLOCKS
	int "Number of blocks (4, 8, 12, 16)"
	default 12

config SW_CODEC_SBC_NO_OF_SUBBANDS
	int "Number of subbands (4, 8)"
	default 8

config SW_CODEC_SBC_BIT_ALLOC_METHOD
	int "Bit allocation Method (0 -> Loudness, 1 -> SNR)"
	default 0

config SW_CODEC_SBC_CHANNEL_MODE_MONO
	int "Channel Mode Mono (0->Mono)"
	default 0
	help
		Only mono is supported at the moment

endmenu # SBC
endmenu # Encoder
endmenu # SW Codec

#----------------------------------------------------------------------------#
menu "FIFO"

config FIFO_FRAME_SPLIT_NUM
	int "Number of blocks to make up one frame of audio data"
	default 10
	help
		Easy DMA in I2S requires two buffers to be filled before I2S
		transmission will begin. In order to reduce latency, an audio
		frame can be split into multiple block with this parameter. USB
		sends data in 1 ms blocks, so we need the split to match that.
		Since we set frame size to 10 ms for USB, 10 is selected as
		FRAME_SPLIT_NUM

config FIFO_TX_FRAME_COUNT
	int "Max number of audio frames in TX slab"
	default 3
	help
		FIFO_TX is the buffer that holds decoded audio data before it
		is sent to either I2S or USB

config FIFO_RX_FRAME_COUNT
	int "Max number of audio frames in RX slab"
	default 1
	help
		FIFO_RX is the buffer that holds uncompressed audio data coming
		from either I2S or USB

endmenu # FIFO

#----------------------------------------------------------------------------#
menu "Stream"

config BUF_BLE_RX_PACKET_NUM
	int
	default 5
	range 2 5
	help
		Value can be adjusted to affect the overall latency.
		This adjusts the number packets in the BLE FIFO RX buffer,
		which is where the main latency resides. A low value will decrease
		latency and reduce stability, and vice-versa.
		Two is recommended minimum to reduce the likelyhood of audio
		gaps due to a BLE retransmit.

config STREAM_BIDIRECTIONAL
	bool "Enable bi-directional stream - Currently not supported"
	default n
	help
		Bi-directional stream enables encoder and decoder on both sides,
		and one device can both send and receive audio.

config BLE_ISO_RX_STATS_S
	int "Interval in seconds to print BLE ISO RX stats. 0 to deactivate"
	default 0


endmenu # Stream
endmenu # Audio

#----------------------------------------------------------------------------#
menu "Power measurement"

config POWER_MODULE_MIN_MEAS_TIME_MS
	int "Power measurement interval in milliseconds"
	default 200

config POWER_MODULE_MEAS_START_ON_BOOT
	bool "Start power measurements for all rails on boot"
	default n
	help
		This option will automatically start and periodically print
		the voltage, current consumption, and power usage for the
		following rails: VBAT, VDD1_CODEC, VDD2_CODEC, and VDD2_NRF

endmenu # Power measurement

#----------------------------------------------------------------------------#
menu "RTT"

config RTT_CHANNEL
	int "RTT Channel"
	default 1

config RTT_BUFFER_SIZE
	int "RTT Buffer Size"
	default 4096

endmenu # RTT

#----------------------------------------------------------------------------#
menu "Stack sizes"

config ENCODER_STACK_SIZE
	int "Stack size for encoder thread"
	default 6750 if AUDIO_BIT_DEPTH_16
	default 11264 if AUDIO_BIT_DEPTH_24 || AUDIO_BIT_DEPTH_32

config AUDIO_DATAPATH_STACK_SIZE
	int "Stack size for audio datapath thread"
	default 4096 if AUDIO_BIT_DEPTH_16
	default 7168 if AUDIO_BIT_DEPTH_24 || AUDIO_BIT_DEPTH_32

config PRINT_STACK_USAGE_MS
	int "Print stack usage every x milliseconds"
	default 5000

config POWER_MODULE_STACK_SIZE
	int "Stack size for power module"
	default 1152

config CS47L63_STACK_SIZE
	int "Stack size for CS47L63"
	default 650

endmenu # Stack sizes

#----------------------------------------------------------------------------#
menu "Thread priorities"

config ENCODER_THREAD_PRIO
	int "Priority for encoder thread"
	default 3
	help
		This is a preemptible thread

config AUDIO_DATAPATH_THREAD_PRIO
	int "Priority for audio datapath thread"
	default 4
	help
		This is a preemptible thread

config POWER_MODULE_THREAD_PRIO
	int "Priority for power measurement thread"
	default 6
	help
		This is a preemptible thread

config CS47L63_THREAD_PRIO
	int "Priority for CS47L63 thread"
	default 5
	help
		This is a preemptible thread

endmenu # Thread priorities

#----------------------------------------------------------------------------#
menu "LOG levels"

config LOG_MAIN_LEVEL
	int "Log level for main file"
	default 3

config LOG_AUDIO_CODEC_LEVEL
	int "Log level for streamctrl"
	default 3

config LOG_STREAMCTRL_LEVEL
	int "Log level for streamctrl"
	default 3

config LOG_BLE_LEVEL
	int "Log level for Bluetooth related files"
	default 3

config LOG_CTRL_EVENTS_LEVEL
	int "Log level for ctrl_events.c"
	default 2

config LOG_I2S_LEVEL
	int "Log level for audio_i2s"
	default 2

config LOG_LED_LEVEL
	int "Log level for LED"
	default 2

config LOG_AUDIO_USB_LEVEL
	int "Log level for USB audio"
	default 2

config LOG_POWER_MODULE_LEVEL
	int "Log level for power module"
	default 3

config LOG_PMIC_LEVEL
	int "Log level for PMIC"
	default 2

config LOG_CS47L63_LEVEL
	int "Log level for CS47L63"
	default 2

config LOG_HW_CODEC_LEVEL
	int "Log level for HW_CODEC"
	default 2

config LOG_BUTTON_HANDLER_LEVEL
	int "Log level for button_handler.c"
	default 2

config LOG_BOARD_VERSION_LEVEL
	int "Log level for the board/HW version"
	default 3

config LOG_AUDIO_DATAPATH_LEVEL
	int "Log level for audio_datapath"
	default 3

config LOG_AUDIO_SYNC_TIMER_LEVEL
	int "Log level for audio_sync_timer"
	default 3

config LOG_SD_CARD_LEVEL
	int "Log level for SD card"
	default 2

endmenu #LOG levels

#----------------------------------------------------------------------------#
menu "I2S"

config I2S_ENABLED
	bool "Enable I2S driver"
	default y

config I2S_LRCK_FREQ_HZ
	int "Sample rate for I2S. Typically 16000, 44100 or 48000"
	default AUDIO_SAMPLE_RATE_HZ
	help
	 The sample rate of I2S. For now this is tied directly to
	 AUDIO_SAMPLE_RATE_HZ
	 Note that this setting is only valid in I2S master mode.

config I2S_CH_NUM
	int "Number of I2S channels. Mono or stereo"
	default 2
	range 2 2
	help
	 The I2S driver itself supports both mono and stereo.
	 Parts of the implementation are configured for only stereo.

config I2S_TX_ENABLED
	bool "Enable I2S TX"
	default y
	select I2S_ENABLED

config I2S_RX_ENABLED
	bool "Enable I2S RX"
	default y
	select I2S_ENABLED

endmenu # I2S

#----------------------------------------------------------------------------#
menu "BLE"

config BLE_ACL_CONN_INTERVAL
	int "BLE ACL Connection Interval (x*1.25ms)"
	default 100

config BLE_ACL_SLAVE_LATENCY
	int "BLE Slave Latency"
	default 0

config BLE_ACL_SUP_TIMEOUT
	int "BLE Supervision Timeout (x*10ms)"
	default 400

config BLE_LE_POWER_CONTROL_ENABLED
	bool "Enable LE power control feature"
	default n
	help
	 The LE power control feature makes devices be able to change TX power
	 dynamically and automatically during connection, which provides effective
	 communication.

config BLE_DEVICE_NAME_BASE
	string
	default "NRF5340_AUDIO_DEV"
	help
	 Base for the device name that will be visible over the air

config BLE_ISO_TEST_PATTERN
	bool "Transmit a test pattern to measure link performance"
	default n
	help
	 This will transmit the same amount of data as an audio stream, but the
	 data will be an incrementing value ranging from 0-255 and repeating.
	 Note that enabling this feature will disable the audio stream.

endmenu # BLE
endmenu # nRF5340 Audio Config
```

## applications/nrf5340_audio/projects/nrf5340_audio_app/dts/bindings/gpio-nrf5340-audio-dk.yaml
```yaml
# Copyright (c) 2018, Linaro Limited
# SPDX-License-Identifier: Apache-2.0

description: GPIO nrf5340_audio_dk parent node

compatible: "gpio-nrf5340-audio-dk"

child-binding:
    description: GPIO child node
    properties:
       gpios:
          type: phandle-array
          required: true
       label:
          required: true
          type: string
          description: Human readable string describing the device (used by Zephyr for API name)
```

## tests/nrf5340_audio/contin_array/testcase.yaml
```yaml
#
# Copyright (c) 2018 Nordic Semiconductor ASA
#
# SPDX-License-Identifier: LicenseRef-Nordic-5-Clause
#

tests:
  nrf5340_audio.contin_array_test:
    platform_allow: qemu_cortex_m3
    tags: contin_array, nrf5340_audio_unit_tests
```

## tests/nrf5340_audio/unit_test_example/testcase.yaml
```yaml
tests:
  nrf5340_audio.test_example:
    platform_allow: qemu_cortex_m3
    tags: unit_example, nrf5340_audio_unit_tests
```
